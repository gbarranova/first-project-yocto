## build/conf/bblayers.conf
```bitbake
# POKY_BBLAYERS_CONF_VERSION is increased each time build/conf/bblayers.conf
# changes incompatibly
POKY_BBLAYERS_CONF_VERSION = "2"

BBPATH = "${TOPDIR}"
BBFILES ?= ""

BBLAYERS ?= " \
  /home/newbar22/yocto_project/poky/meta \
  /home/newbar22/yocto_project/poky/meta-poky \
  /home/newbar22/yocto_project/poky/meta-yocto-bsp \
  /home/newbar22/yocto_project/meta-sunxi\
  /home/newbar22/yocto_project/meta-openembedded/meta-oe \
  /home/newbar22/yocto_project/meta-openembedded/meta-python \
  "
```

## meta-newbar/conf/layer.conf
```bitbake
# We have a conf and classes directory, add to BBPATH
BBPATH .= ":${LAYERDIR}"

# We have recipes-* directories, add to BBFILES
BBFILES += "${LAYERDIR}/recipes-*/*/*.bb \
            ${LAYERDIR}/recipes-*/*/*.bbappend"

BBFILE_COLLECTIONS += "newbar"
BBFILE_PATTERN_newbar = "^${LAYERDIR}/"
BBFILE_PRIORITY_newbar = "5"
LAYERVERSION_newbar = "4"
LAYERSERIES_COMPAT_newbar = "kirkstone"
```
